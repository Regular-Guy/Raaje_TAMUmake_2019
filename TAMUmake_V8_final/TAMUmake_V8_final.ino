// TAMUmake 2019
// IEEE | TAMU
// Team Raaje with an AJ
// Version 3

#include <LiquidCrystal.h>
#include <PCM.h>

//Ultrasonic sensor
#define trigPin 0
#define echoPin 1

//buttons
#define b_h 8
#define b_m 7
#define b_startstop 2

//LCD display
#define rs 12
#define en 10
#define d4 5 
#define d5 4 
#define d6 3 
#define d7 6
LiquidCrystal lcd(rs, en, d4, d5, d6, d7);

// alarm sound file
const unsigned char sample[] PROGMEM = {
  124, 124, 126, 125, 125, 124, 125, 126, 125, 126, 127, 127,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 130, 
};

//Time
volatile int sec = 0;
volatile int minute = 0;
volatile int hour = 0;

volatile int state = 1;

//Alarm time
int alarmHour;
int alarmMinute;
bool dismiss;

//interrupt debouncing
long debouncing_time = 15;
volatile unsigned long last_micros;;

void setup() {

  //set up the LCD
  lcd.begin(16, 2);
  lcd.setCursor(0, 0);

  //Set up buttons
  pinMode(b_h, INPUT_PULLUP);
  pinMode(b_m, INPUT_PULLUP);
  pinMode(b_startstop, INPUT_PULLUP);

  attachInterrupt(digitalPinToInterrupt(b_startstop), debounceInterruptClock, FALLING);

  // alarm sound setup
  startPlayback(sample, sizeof(sample));

  //Set alarm time
  alarmHour = 0;
  alarmMinute = 1;
  dismiss = false;

  //Ultrasonic setup
  pinMode(trigPin, OUTPUT);
  pinMode(echoPin, INPUT);
  pinMode(LED_BUILTIN, OUTPUT);

}

void loop() {
  //Setting the time will stop the clock to set the time
  switch(state) {
    case 0:
      setTime();
      break;
    case 1:
      keepTime();
      break;
    case 2:
      setAlarm();
      break;
  }
}

void debounceInterruptClock(){
 if((long)(micros() - last_micros) >= debouncing_time * 1000) {
   setState();
   last_micros = micros();
 }
}

void setState(){
  lcd.clear();
  state++;
  if(state > 3){
    state = 0;
    lcd.clear();
  }
}

void setTime(){
  lcd.setCursor(0, 1);
  lcd.print("Set Time");
  delay(1000);
  lcd.setCursor(0, 0);
  lcd.print("Time: ");
     
  if(hour<10) {
    lcd.print("0");
    lcd.print(hour);
       
  } else {
    lcd.print(hour);
  }
    
  lcd.print(":");
     
  if(minute<10) {
    lcd.print("0");
    lcd.print(minute);
      
  } else {
    lcd.print(minute);
  }
  lcd.print(":");
      
  if(sec<10) {
    lcd.print("0");  
    lcd.print(sec);
      
  } else {
    lcd.print(sec);
  }
      
  lcd.print(" ");

  if (digitalRead(b_h) == LOW) {
    hour++;
  }
      
  if (hour > 23){
    hour = 0;
  }

  if (digitalRead(b_m) == LOW)
  {
    minute++;
    if (minute > 59)
        minute = 0;
    }
}

void keepTime(){
  lcd.setCursor(0, 0);
  //sec=millis()/1000;
  delay(1000);
  lcd.print("Time: ");
  if (hour < 10)
  {
    lcd.print("0");
  }
  lcd.print(hour);
  lcd.print(":");
  if (minute < 10)
  {
    lcd.print("0");
  }
  lcd.print(minute);
  lcd.print(":");
  if (sec < 10)
  {
   lcd.print("0");
  }
  lcd.print(sec);
  lcd.print(" ");
  
  sec++;
  if (sec > 59)
  {
    minute++;
    sec = 0;
  }
  if (minute > 59) {
    hour++;
    minute = 0;
  }
  if (hour > 23)
  {
    hour = 0;
    minute = 0;
    sec = 0;
    dismiss = false;
  }

  if((hour > alarmHour || (minute >= alarmMinute && hour == alarmHour)) && !dismiss) {
    startPlayback(sample, sizeof(sample));
    digitalWrite(LED_BUILTIN, HIGH);
  } else {
    stopPlayback();
    digitalWrite(LED_BUILTIN, LOW);
  }
  
  //Ultrasonic sensor code
  long duration;
  long distance;
  digitalWrite(trigPin, LOW);        
  digitalWrite(trigPin, HIGH);          
  digitalWrite(trigPin, LOW);
  duration = pulseIn(echoPin, HIGH);
  distance = (duration/2) / 29.1;

  if((hour > alarmHour || (minute >= alarmMinute && hour == alarmHour)) && !dismiss) {
    startPlayback(sample, sizeof(sample));
    digitalWrite(LED_BUILTIN, HIGH);

    if (distance <= 20) {
      dismiss = true;
    }
  } else {
    stopPlayback();
    digitalWrite(LED_BUILTIN, LOW);
  }
}

void setAlarm(){
  lcd.setCursor(0, 1);
  lcd.print("Set Alarm");
  delay(100);
  lcd.setCursor(0, 0);
  lcd.print("Time: ");
     
  if(alarmHour<10) {
    lcd.print("0");
    lcd.print(alarmHour);
       
  } else {
    lcd.print(alarmHour);
  }
    
  lcd.print(":");
     
  if(alarmMinute<10) {
    lcd.print("0");
    lcd.print(alarmMinute);
      
  } else {
    lcd.print(alarmMinute);
  }
      
  lcd.print(" ");

  if (digitalRead(b_h) == LOW) {
    alarmHour++;
  }
      
  if(alarmHour > 23){
    alarmHour = 0;
  }

  if (digitalRead(b_m) == LOW)
  {
    alarmMinute++;
    if (alarmMinute > 59)
        alarmMinute = 0;
    }
}
